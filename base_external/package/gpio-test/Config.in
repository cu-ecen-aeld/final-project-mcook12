## base_external/package/gpio-test/Config.in
```kconfig
 

config BR2_PACKAGE_GPIO_TEST
	bool "gpio-test"
	help
	  Includes modules for testing GPIO output to LED.
```

## base_external/package/i2c-test/Config.in
```kconfig
 

config BR2_PACKAGE_I2C_TEST
	bool "i2c-test"
	help
	  Includes modules for testing adc.
```
